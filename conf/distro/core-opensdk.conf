## conf/distro/core-opensdk.conf
```bitbake
#@NAME: core-opensdk
#@DESCRIPTION: core opensdk (without MM) using by default OpenEmbedded build configuration

# Distribution definition for: opensdk

# from dev manual:
# Your configuration file needs to set the following variables:
#
#      DISTRO_NAME [required]
#      DISTRO_VERSION [required]
#      DISTRO_FEATURES [required if creating from scratch]
#      DISTRO_EXTRA_RDEPENDS [optional]
#      DISTRO_EXTRA_RRECOMMENDS [optional]
#      TCLIBC [required if creating from scratch]


DISTRO = "core-opensdk"
DISTRO_NAME = "OpenSDK (A Yocto Project 2.0 based Distro)"
DISTRO_VERSION = "1.0"
DISTRO_CODENAME = "jethro"
SDK_VENDOR = "-opensdk"
SDK_VERSION := "${@'${DISTRO_VERSION}'.replace('snapshot-${DATE}','snapshot')}"

MAINTAINER = "Christophe Priouzeau <christophe.priouzeau@st.com>"

TARGET_VENDOR = "-opensdk"

LOCALCONF_VERSION = "1"
LAYER_CONF_VERSION ?= "6"

# TODO: is that really want we want?
IMAGE_LINGUAS = "en-gb"


DISTRO_FEATURES = " \
        alsa argp ext2 ext4 largefile usbgadget usbhost \
        ipv4 ipv6 wifi nfs zeroconf \
        xattr \
        ${DISTRO_FEATURES_LIBC}"

DISTRO_FEATURES_append = " multiarch"

# add support of opengl
#DISTRO_FEATURES_append = " opengl"



#mirror
PREMIRRORS ??= "\
bzr://.*/.*   http://downloads.yoctoproject.org/mirror/sources/ \n \
cvs://.*/.*   http://downloads.yoctoproject.org/mirror/sources/ \n \
git://.*/.*   http://downloads.yoctoproject.org/mirror/sources/ \n \
gitsm://.*/.* http://downloads.yoctoproject.org/mirror/sources/ \n \
hg://.*/.*    http://downloads.yoctoproject.org/mirror/sources/ \n \
osc://.*/.*   http://downloads.yoctoproject.org/mirror/sources/ \n \
p4://.*/.*    http://downloads.yoctoproject.org/mirror/sources/ \n \
svn://.*/.*   http://downloads.yoctoproject.org/mirror/sources/ \n"

MIRRORS =+ "\
ftp://.*/.*      http://downloads.yoctoproject.org/mirror/sources/ \n \
http://.*/.*     http://downloads.yoctoproject.org/mirror/sources/ \n \
https://.*/.*    http://downloads.yoctoproject.org/mirror/sources/ \n"

# We dont want (L)GPL-3.0+
INCOMPATIBLE_LICENSE = "GPLv3.0 GPLv3 GPL-3.0 GPLv3+ LGPLv3.0 LGPLv3 LGPL-3.0 LGPLv3+"
#gdb: for debug on dev image
#binutils: used at compilation time
#ccache: used at compilation time
#autoconf: used at compilation time
#gcc: used at compilation time
#mpfr: used at compilation time
#libmpc used at compilation time
#tcpreplay  for debug on dev image
OPENSDK_WHITELIST_GPLv3 = "gdb binutils ccache less autoconf gcc mpfr libmpc tcpreplay"
WHITELIST_GPLv3.0+ = "${OPENSDK_WHITELIST_GPLv3}"
WHITELIST_LGPLv3.0 = "${OPENSDK_WHITELIST_GPLv3}"
WHITELIST_GPL-3.0 = "${OPENSDK_WHITELIST_GPLv3}"
WHITELIST_GPL-3.0+ = "${OPENSDK_WHITELIST_GPLv3}"

#--------------------------
# Preferred version

# gstreamer configuration
PREFERRED_VERSION_gstreamer1.0 = "local"
PREFERRED_VERSION_gstreamer1.0-plugins-base = "local"
PREFERRED_VERSION_gstreamer1.0-plugins-good = "local"
PREFERRED_VERSION_gstreamer1.0-plugins-ugly = "1.6.0"
PREFERRED_VERSION_gstreamer1.0-plugins-bad = "local"
PREFERRED_VERSION_gstreamer1.0-plugins-stm = "local"

# mesa
PREFERRED_VERSION_mesa = "10.6.3"

# wayland / weston
#PREFERRED_VERSION_wayland = "local"
PREFERRED_VERSION_wayland = "1.9.0"
PREFERRED_VERSION_wayland-native = "1.9.0"
PREFERRED_VERSION_weston = "local"

# libdrm
#PREFERRED_VERSION_libdrm = "local"

# v4l-utils
PREFERRED_VERSION_v4l-utils = "1.0+local"
```

## conf/distro/include/exception-gplv3.inc
```bitbake
#@DESCRIPTION: ST GPLv3 exception

#--------------------------
# License settings
#
# We dont want (L)GPL-3.0+
INCOMPATIBLE_LICENSE = "GPLv3.0 GPLv3 GPL-3.0 GPLv3+ LGPLv3.0 LGPLv3 LGPL-3.0 LGPLv3+"

OPENSDK_WHITELIST_GPLv3 = ""
OPENSDK_WHITELIST_GPLv3 += "${@bb.utils.contains('DISTRO_FEATURES', 'tpm', 'nano msmtp', '', d)}"

WHITELIST_GPLv3.0+ = "${OPENSDK_WHITELIST_GPLv3}"
WHITELIST_LGPLv3.0 = "${OPENSDK_WHITELIST_GPLv3}"
WHITELIST_GPL-3.0 = "${OPENSDK_WHITELIST_GPLv3}"
WHITELIST_GPL-3.0+ = "${OPENSDK_WHITELIST_GPLv3}"
```

## conf/distro/include/st-default-distro-providers.inc
```bitbake
#@DESCRIPTION: ST default distro providers

PREFERRED_PROVIDER_libevent = "libevent-fb"
PREFERRED_PROVIDER_jpeg = "libjpeg-turbo"
PREFERRED_PROVIDER_jpeg-native = "libjpeg-turbo-native"

#--------------------------
# Preferred provider
# for openvt tools
PREFERRED_PROVIDER_console-tools = "kbd"

#--------------------------
# Preferred provider
# splash
SPLASH = "psplash-drm"
PREFERRED_PROVIDER_virtual/psplash = "psplash-drm"
```

## conf/distro/include/stm-default-distro-providers.inc
```bitbake
#@DESCRIPTION: STM default distro providers

PREFERRED_PROVIDER_libevent = "libevent-fb"
PREFERRED_PROVIDER_jpeg = "libjpeg-turbo"
PREFERRED_PROVIDER_jpeg-native = "libjpeg-turbo-native"
```

## conf/distro/include/stm-default-distro-rules.inc
```bitbake
#@DESCRIPTION: STM default distro rules

#--------------------------
# Mirror settings
#
YOCTOPROJECT_MIRROR_URL = "http://downloads.yoctoproject.org/mirror/sources/"

MIRRORS =+ "\
ftp://.*/.*    ${YOCTOPROJECT_MIRROR_URL} \n \
http://.*/.*   ${YOCTOPROJECT_MIRROR_URL} \n \
https://.*/.*  ${YOCTOPROJECT_MIRROR_URL} \n"

INHERIT += "own-mirrors"
SOURCE_MIRROR_URL ??= "${YOCTOPROJECT_MIRROR_URL}"

#--------------------------
# The CONNECTIVITY_CHECK_URI's are used to test whether we can succesfully
# fetch from the network (and warn you if not).
# URI's to check can be set in the CONNECTIVITY_CHECK_URIS variable
# using the same syntax as for SRC_URI. If the variable is not set
# the check is skipped
#
CONNECTIVITY_CHECK_URIS ?= " \
    https://eula-downloads.yoctoproject.org/index.php \
    http://bugzilla.yoctoproject.org/report.cgi"

#--------------------------
# OELAYOUT_ABI allows us to notify users when the format of TMPDIR changes in
# an incompatible way. Such changes should usually be detailed in the commit
# that breaks the format and have been previously discussed on the mailing list
# with general agreement from the core team.
#
OELAYOUT_ABI = "11"

#--------------------------
# License settings
#
# We dont want (L)GPL-3.0+
INCOMPATIBLE_LICENSE = "GPLv3.0 GPLv3 GPL-3.0 GPLv3+ LGPLv3.0 LGPLv3 LGPL-3.0 LGPLv3+"
#binutils: used at compilation time
#ccache: used at compilation time
#autoconf: used at compilation time
#gcc: used at compilation time
#mpfr: used at compilation time
#libmpc used at compilation time
OPENSDK_WHITELIST_GPLv3 = "binutils ccache less autoconf gcc mpfr libmpc"
WHITELIST_GPLv3.0+ = "${OPENSDK_WHITELIST_GPLv3}"
WHITELIST_LGPLv3.0 = "${OPENSDK_WHITELIST_GPLv3}"
WHITELIST_GPL-3.0 = "${OPENSDK_WHITELIST_GPLv3}"
WHITELIST_GPL-3.0+ = "${OPENSDK_WHITELIST_GPLv3}"

#--------------------------
# Tune build config display
#
BUILDCFG_VARS += "GCCVERSION"
BUILDCFG_VARS += "PREFERRED_PROVIDER_virtual/kernel"
BUILDCFG_VARS += "PREFERRED_VERSION_${PREFERRED_PROVIDER_virtual/kernel}"

#--------------------------
# Writes build information to target filesystem on /etc/build
#
IMAGE_BUILDINFO_VARS = "${BUILDCFG_VARS}"
INHERIT += "image-buildinfo"
```

## conf/distro/opensdk.conf
```bitbake
#@NAME: opensdk
#@DESCRIPTION: core opensdk + MM + systemd using by default OpenEmbedded build configuration

require core-opensdk.conf

DISTRO = "opensdk"

DISTRO_FEATURES_append = " opengl"

# add support of gstreamer
DISTRO_FEATURES_append += " gstreamer "

# add support of x11
#DISTRO_FEATURES_append += " x11 "

#add support of bluetooth
#DISTRO_FEATURES_append += " bluetooth "

# add support of wayland
DISTRO_FEATURES_append += " wayland pam"

# add support of systemd
DISTRO_FEATURES_append += " systemd "

# Disabling sysvinit
DISTRO_FEATURES_BACKFILL_CONSIDERED += "sysvinit"

VIRTUAL-RUNTIME_init_manager = "systemd"
VIRTUAL-RUNTIME_initscripts = "systemd-compat-units"

LICENSE_FLAGS_WHITELIST += " commercial"
```

## conf/distro/openstlinux-eglfs.conf
```bitbake
#@NAME: openstlinux-eglfs
#@DESCRIPTION: OpenSTLinux featuring eglfs - no X11, no Wayland (with gplv3 software)

require include/st-default-distro-rules.inc
require include/st-default-distro-providers.inc
require include/openstlinux.inc

# Distribution definition for: st-openstlinux

DISTRO = "openstlinux-eglfs"
DISTRO_NAME = "ST OpenSTLinux - EGLfs  -(A Yocto Project 2.2 based Distro)"

# Warning: TARGET_VENDOR does not contains a valid OS/ARCH name like : linux, arm
# Warning: undercore are forbidden between each word of TARGET_VENDOR
TARGET_VENDOR = "-openstlinux_eglfs"

SDK_VENDOR = "-openstlinux_eglfs_SDK"
SDK_VERSION := "${@'${DISTRO_VERSION}'.replace('snapshot-${DATE}','snapshot')}"

DISTRO_FEATURES_append = " opengl "
DISTRO_FEATURES_remove = " wayland x11 "

DISTRO_FEATURES_append = " gplv3 "
```

## conf/distro/openstlinux-weston-gplv3.conf
```bitbake
#@NAME: openstlinux-weston-gplv3
#@DESCRIPTION: OpenSTLinux featuring Weston/Wayland (with GPLv3 software)

require include/st-default-distro-rules.inc
require include/st-default-distro-providers.inc
require include/openstlinux.inc

# Distribution definition for: st-opensdk

DISTRO = "openstlinux-weston-gplv3"
DISTRO_NAME = "ST OpenSTLinux - Weston -(A Yocto Project 2.2 based Distro)"

# Warning: TARGET_VENDOR does not contains a valid OS/ARCH name like : linux, arm
# Warning: undercore are forbidden between each word of TARGET_VENDOR
TARGET_VENDOR = "-openstlinux_weston"

# Warning: undercore are forbidden between each word of SDK_VENDOR
SDK_VENDOR = "-openstlinux_weston_gplv3_SDK"
SDK_VERSION := "${@'${DISTRO_VERSION}'.replace('snapshot-${DATE}','snapshot')}"

DISTRO_FEATURES_append = " opengl"
DISTRO_FEATURES_remove = " x11 "

DISTRO_FEATURES_append = " gplv3 "
```

## conf/distro/openstlinux-weston-nogplv3-hw.conf
```bitbake
#@NAME: openstlinux-weston-gplv3-hw
#@DESCRIPTION: OpenSTLinux featuring Weston/Wayland - hardware video decode (without GPLv3 software)

require include/st-default-distro-rules.inc
require include/st-default-distro-providers.inc
require include/exception-gplv3.inc
require include/openstlinux.inc

# Distribution definition for: st-openstlinux-weston

DISTRO = "openstlinux-weston-nogplv3-hw"
DISTRO_NAME = "ST OpenSTLinux - Weston - (A Yocto Project Based Distro)"

# Warning: TARGET_VENDOR does not contains a valid OS/ARCH name like : linux, arm
# Warning: undercore are forbidden between each word of TARGET_VENDOR
TARGET_VENDOR = "-openstlinux_weston_hw"

SDK_VENDOR = "-openstlinux_weston_nogplv3_hw_SDK"

SDK_VERSION := "${@'${DISTRO_VERSION}'.replace('snapshot-${DATE}','snapshot')}"

DISTRO_FEATURES_append = " hwdecode"
DISTRO_FEATURES_append = " opengl"
DISTRO_FEATURES_remove = " x11 "
```

## conf/distro/openstlinux-weston-nogplv3.conf
```bitbake
#@NAME: openstlinux-weston-nogplv3
#@DESCRIPTION: OpenSTLinux featuring Weston/Wayland (without GPLv3 software)

require include/st-default-distro-rules.inc
require include/st-default-distro-providers.inc
require include/exception-gplv3.inc
require include/openstlinux.inc

# Distribution definition for: st-openstlinux-weston

DISTRO = "openstlinux-weston-nogplv3"
DISTRO_NAME = "ST OpenSTLinux - Weston -(A Yocto Project 2.2 based Distro)"

# Warning: TARGET_VENDOR does not contains a valid OS/ARCH name like : linux, arm
# Warning: undercore are forbidden between each word of TARGET_VENDOR
TARGET_VENDOR = "-openstlinux_weston"

# Warning: undercore are forbidden between each word of SDK_VENDOR
SDK_VENDOR = "-openstlinux_weston_nogplv3_SDK"
SDK_VERSION := "${@'${DISTRO_VERSION}'.replace('snapshot-${DATE}','snapshot')}"

DISTRO_FEATURES_append = " opengl"
DISTRO_FEATURES_remove = " x11 "
```

## conf/distro/openstlinux-x11.conf
```bitbake
#@NAME: openstlinux-x11
#@DESCRIPTION: OpenSTLinux with X11 features (with gplv3 software)

require include/st-default-distro-rules.inc
require include/st-default-distro-providers.inc
require include/openstlinux.inc

# Distribution definition for: openstlinux-x11

DISTRO = "openstlinux-x11"
DISTRO_NAME = "ST OpenSTLinux - X11 - (A Yocto Project 2.2 based Distro)"

# Warning: TARGET_VENDOR does not contains a valid OS/ARCH name like : linux, arm
# Warning: undercore are forbidden between each word of TARGET_VENDOR
TARGET_VENDOR = "-openstlinux_x11"

# Warning: undercore are forbidden between each word of SDK_VENDOR
SDK_VENDOR = "-openstlinux_x11_SDK"
SDK_VERSION := "${@'${DISTRO_VERSION}'.replace('snapshot-${DATE}','snapshot')}"

DISTRO_FEATURES_append = " opengl"
DISTRO_FEATURES_remove = " wayland "

DISTRO_FEATURES_append = " gplv3 "
```

## conf/distro/poky-core-opensdk.conf
```bitbake
#@NAME: poky-core-opensdk
#@DESCRIPTION: Select POKY build configuration for core-opensdk distro (without MM, systemd)

require core-opensdk.conf

DISTRO = "poky-core-opensdk"
```

## conf/distro/poky-opensdk.conf
```bitbake
#@NAME: poky-opensdk
#@DESCRIPTION: Select POKY build configuration for opensdk distro (core-opensdk + MM + systemd)

require opensdk.conf

DISTRO = "poky-opensdk"
```

## conf/distro/st-core.conf
```bitbake
#@NAME: st-core
#@DESCRIPTION: OpenSDK without Hw MultiMedia features

require include/st-default-distro-rules.inc
require include/st-default-distro-providers.inc
require include/st-opensdk.inc

# Distribution definition for: st-core

DISTRO = "st-core"
DISTRO_NAME = "ST OpenSDK - software - (A Yocto Project 2.0 based Distro)"

SDK_VENDOR = "-stcore_SDK"
SDK_VERSION := "${@'${DISTRO_VERSION}'.replace('snapshot-${DATE}','snapshot')}"

TARGET_VENDOR = "-stcore"

DISTRO_FEATURES_append = " swdecode"
DISTRO_FEATURES_append = " opengl"
```

## conf/distro/st-eglfs.conf
```bitbake
#@NAME: st-opensdk
#@DESCRIPTION: OpenSDK featuring Multimedia

require include/st-default-distro-rules.inc
require include/st-default-distro-providers.inc
require include/st-opensdk.inc

# Distribution definition for: st-opensdk

DISTRO = "st-eglfs"
DISTRO_NAME = "ST OpenSDK - EGLFS  -(A Yocto Project 2.2 based Distro)"

SDK_VENDOR = "-steglfs_SDK"
SDK_VERSION := "${@'${DISTRO_VERSION}'.replace('snapshot-${DATE}','snapshot')}"

TARGET_VENDOR = "-steglfs"

DISTRO_FEATURES_append = " opengl "
DISTRO_FEATURES_remove = " wayland x11 "

#for Qt5
PACKAGECONFIG_append_pn-qtbase = " eglfs kms"
```

## conf/distro/st-opensdk.conf
```bitbake
#@NAME: st-opensdk
#@DESCRIPTION: OpenSDK featuring Multimedia

require include/st-default-distro-rules.inc
require include/st-default-distro-providers.inc
require include/st-opensdk.inc

# Distribution definition for: st-opensdk

DISTRO = "st-opensdk"
DISTRO_NAME = "ST OpenSDK - hardware -(A Yocto Project 2.2 based Distro)"

SDK_VENDOR = "-stopensdk_SDK"
SDK_VERSION := "${@'${DISTRO_VERSION}'.replace('snapshot-${DATE}','snapshot')}"

TARGET_VENDOR = "-stopensdk"

DISTRO_FEATURES_append = " opengl"
```

## conf/distro/stm-core-systemd.conf
```bitbake
#@NAME: stm-core-systemd
#@DESCRIPTION: Core distro without MultiMedia features using SystemD init

require include/stm-default-distro-rules.inc
require include/stm-default-distro-providers.inc

# Distribution definition for: stm-core-systemd

# from dev manual:
# Your configuration file needs to set the following variables:
#
#      DISTRO_NAME [required]
#      DISTRO_VERSION [required]
#      DISTRO_FEATURES [required if creating from scratch]
#      DISTRO_EXTRA_RDEPENDS [optional]
#      DISTRO_EXTRA_RRECOMMENDS [optional]
#      TCLIBC [required if creating from scratch]

DISTRO = "stm-core-systemd"
DISTRO_NAME = "STM CoreSystemD (A Yocto Project 2.0 based Distro)"
DISTRO_VERSION = "1.0"
DISTRO_CODENAME = "jethro"

SDK_VENDOR = "-stmcoresystemd"
SDK_VERSION := "${@'${DISTRO_VERSION}'.replace('snapshot-${DATE}','snapshot')}"

MAINTAINER = "Christophe Priouzeau <christophe.priouzeau@st.com>"

TARGET_VENDOR = "-stmcoresystemd"

LOCALCONF_VERSION = "1"
LAYER_CONF_VERSION ?= "6"

# TODO: is that really want we want?
IMAGE_LINGUAS = "en-gb"

DISTRO_FEATURES  = "alsa"
DISTRO_FEATURES += "argp"
DISTRO_FEATURES += "ext2"
DISTRO_FEATURES += "ext4"
DISTRO_FEATURES += "largefile"
DISTRO_FEATURES += "ipv4"
DISTRO_FEATURES += "ipv6"
DISTRO_FEATURES += "multiarch"
DISTRO_FEATURES += "wifi"
DISTRO_FEATURES += "nfs"
DISTRO_FEATURES += "usbgadget"
DISTRO_FEATURES += "usbhost"
DISTRO_FEATURES += "xattr"
DISTRO_FEATURES += "zeroconf"
DISTRO_FEATURES += "${DISTRO_FEATURES_LIBC}"

# add support of systemd
DISTRO_FEATURES_append += " systemd "

# Disabling sysvinit
DISTRO_FEATURES_BACKFILL_CONSIDERED += "sysvinit"

VIRTUAL-RUNTIME_init_manager = "systemd"
VIRTUAL-RUNTIME_initscripts = "systemd-compat-units"
```

## conf/distro/stm-ivi.conf
```bitbake
#@NAME: stm-ivi
#@DESCRIPTION: STM-IVI featuring Multimedia based on SystemD init

require include/stm-default-distro-rules.inc
require include/stm-default-distro-providers.inc

# Distribution definition for: stm-ivi

# from dev manual:
# Your configuration file needs to set the following variables:
#
#      DISTRO_NAME [required]
#      DISTRO_VERSION [required]
#      DISTRO_FEATURES [required if creating from scratch]
#      DISTRO_EXTRA_RDEPENDS [optional]
#      DISTRO_EXTRA_RRECOMMENDS [optional]
#      TCLIBC [required if creating from scratch]

DISTRO = "stm-ivi"
DISTRO_NAME = "STM-IVI (A Yocto Project 2.0 based Distro)"
DISTRO_VERSION = "1.0"
DISTRO_CODENAME = "jethro"

SDK_VENDOR = "-stmivi"
SDK_VERSION := "${@'${DISTRO_VERSION}'.replace('snapshot-${DATE}','snapshot')}"

MAINTAINER = "Christophe Priouzeau <christophe.priouzeau@st.com>"

TARGET_VENDOR = "-stmivi"

LOCALCONF_VERSION = "1"
LAYER_CONF_VERSION ?= "6"

# TODO: is that really want we want?
IMAGE_LINGUAS = "en-gb"

DISTRO_FEATURES  = "alsa"
DISTRO_FEATURES += "bluetooth"
DISTRO_FEATURES += "ext2"
DISTRO_FEATURES += "irda"
DISTRO_FEATURES += "largefile"
DISTRO_FEATURES += "ipv4"
DISTRO_FEATURES += "ipv6"
DISTRO_FEATURES += "multiarch"
DISTRO_FEATURES += "wifi"
DISTRO_FEATURES += "nfs"
DISTRO_FEATURES += "pcmcia"
DISTRO_FEATURES += "usbgadget"
DISTRO_FEATURES += "usbhost"
DISTRO_FEATURES += "xattr"
DISTRO_FEATURES += "zeroconf"
DISTRO_FEATURES += "${DISTRO_FEATURES_LIBC}"

DISTRO_FEATURES_append = " opengl"

# add support of gstreamer
DISTRO_FEATURES_append += " gstreamer "

# add support of wayland
DISTRO_FEATURES_append += " wayland pam"

# add support of systemd
DISTRO_FEATURES_append += " systemd "

# Disabling sysvinit
DISTRO_FEATURES_BACKFILL_CONSIDERED += "sysvinit"

VIRTUAL-RUNTIME_init_manager = "systemd"
VIRTUAL-RUNTIME_initscripts = "systemd-compat-units"

LICENSE_FLAGS_WHITELIST += " commercial"


#--------------------------
# Preferred version

# gstreamer configuration
PREFERRED_VERSION_gstreamer1.0 ?= "local"
PREFERRED_VERSION_gstreamer1.0-plugins-base ?= "local"
PREFERRED_VERSION_gstreamer1.0-plugins-good ?= "local"
PREFERRED_VERSION_gstreamer1.0-plugins-ugly ?= "1.6.0"
PREFERRED_VERSION_gstreamer1.0-plugins-bad ?= "local"
PREFERRED_VERSION_gstreamer1.0-plugins-stm ?= "local"

# mesa
PREFERRED_VERSION_mesa ?= "10.6.3"

# wayland / weston
#PREFERRED_VERSION_wayland ?= "local"
PREFERRED_VERSION_wayland ?= "1.9.0"
PREFERRED_VERSION_wayland-native ?= "1.9.0"
PREFERRED_VERSION_weston ?= "local"

# v4l-utils
PREFERRED_VERSION_v4l-utils ?= "1.0+local"
```

## conf/distro/stm-opensdk.conf
```bitbake
#@NAME: stm-opensdk
#@DESCRIPTION: OpenSDK featuring Multimedia based on SystemD init

require include/stm-default-distro-rules.inc
require include/stm-default-distro-providers.inc

# Distribution definition for: stm-opensdk

# from dev manual:
# Your configuration file needs to set the following variables:
#
#      DISTRO_NAME [required]
#      DISTRO_VERSION [required]
#      DISTRO_FEATURES [required if creating from scratch]
#      DISTRO_EXTRA_RDEPENDS [optional]
#      DISTRO_EXTRA_RRECOMMENDS [optional]
#      TCLIBC [required if creating from scratch]

DISTRO = "stm-opensdk"
DISTRO_NAME = "OpenSDK (A Yocto Project 2.0 based Distro)"
DISTRO_VERSION = "1.0"
DISTRO_CODENAME = "jethro"

SDK_VENDOR = "-stmopensdk"
SDK_VERSION := "${@'${DISTRO_VERSION}'.replace('snapshot-${DATE}','snapshot')}"

MAINTAINER = "Christophe Priouzeau <christophe.priouzeau@st.com>"

TARGET_VENDOR = "-stmopensdk"

LOCALCONF_VERSION = "1"
LAYER_CONF_VERSION ?= "6"

# TODO: is that really want we want?
IMAGE_LINGUAS = "en-gb"

DISTRO_FEATURES  = "alsa"
DISTRO_FEATURES += "argp"
DISTRO_FEATURES += "ext2"
DISTRO_FEATURES += "ext4"
DISTRO_FEATURES += "largefile"
DISTRO_FEATURES += "ipv4"
DISTRO_FEATURES += "ipv6"
DISTRO_FEATURES += "multiarch"
DISTRO_FEATURES += "wifi"
DISTRO_FEATURES += "nfs"
DISTRO_FEATURES += "usbgadget"
DISTRO_FEATURES += "usbhost"
DISTRO_FEATURES += "xattr"
DISTRO_FEATURES += "zeroconf"
DISTRO_FEATURES += "${DISTRO_FEATURES_LIBC}"

DISTRO_FEATURES_append = " opengl"

# add support of gstreamer
DISTRO_FEATURES_append += " gstreamer "

# add support of optee
DISTRO_FEATURES_append += " optee "

# add support of wayland
DISTRO_FEATURES_append += " wayland pam"

# add support of X11
#DISTRO_FEATURES_append = " x11"
# add support of X11 via wayland (WARNING: this feature ask to have a dependency on x11)
# if you disable this option, the default xserver will be used.
#DISTRO_FEATURES_append = " x11 xwayland"

# add support of systemd
DISTRO_FEATURES_append += " systemd "

# Disabling sysvinit
DISTRO_FEATURES_BACKFILL_CONSIDERED += "sysvinit"

VIRTUAL-RUNTIME_init_manager = "systemd"
VIRTUAL-RUNTIME_initscripts = "systemd-compat-units"

LICENSE_FLAGS_WHITELIST += " commercial"


#--------------------------
# Preferred version

# gstreamer configuration
PREFERRED_VERSION_gstreamer1.0 ?= "st"
PREFERRED_VERSION_gstreamer1.0-plugins-base ?= "st"
PREFERRED_VERSION_gstreamer1.0-plugins-good ?= "st"
PREFERRED_VERSION_gstreamer1.0-plugins-ugly ?= "1.6.0"
PREFERRED_VERSION_gstreamer1.0-plugins-bad ?= "st"

# mesa
PREFERRED_VERSION_mesa ?= "10.6.3"

# wayland / weston
#PREFERRED_VERSION_wayland ?= "local"
PREFERRED_VERSION_wayland ?= "1.9.0"
PREFERRED_VERSION_wayland-native ?= "1.9.0"
PREFERRED_VERSION_weston ?= "st"

# v4l-utils
PREFERRED_VERSION_v4l-utils ?= "st"
```

## conf/layer.conf
```bitbake
# We have a conf and classes directory, add to BBPATH
BBPATH .= ":${LAYERDIR}"

# We have a recipes-* directories, add to BBFILES
BBFILES += "${LAYERDIR}/recipes-*/*/*.bb \
	${LAYERDIR}/recipes-*/*/*.bbappend"

BBFILE_COLLECTIONS += "st-framework"
BBFILE_PATTERN_st-framework := "^${LAYERDIR}/"
BBFILE_PRIORITY_st-framework = "5"

# path for ST server
ST_GIT_SERVER_URI ?= "git://gerrit.st.com:29418"
ST_GIT_SERVER_PROTOCOL ?= ";protocol=ssh"
```
